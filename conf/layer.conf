## conf/layer.conf
```bitbake
BBPATH .= ":${LAYERDIR}"
BBFILES += "${LAYERDIR}/recipes-*/*/*.bb ${LAYERDIR}/recipes-*/*/*.bbappend"
BBFILE_COLLECTIONS += "meta-colorcreator"
BBFILE_PATTERN_meta-colorcreator = "^${LAYERDIR}/"
BBFILE_PRIORITY_meta-colorcreator = "10"
LAYERSERIES_COMPAT_meta-colorcreator = "dunfell"
```
